## board/qca/arm/ipq806x/meraki-sasquatch.its
```
/dts-v1/;

/ {
    description = "U-Boot FIT";
    #address-cells = <1>;

	images {
		kernel-1 {
			description = "Kernel";
			data = /incbin/("u-boot.bin.gz");
			type = "kernel";
			arch = "arm";
			os = "linux";
			compression = "gzip";
			load = <0x41200000>;
			entry = <0x41200000>;
			hash@1 {
				algo = "sha1";
			};
		};
	};


	configurations {
		default = "config@1";

		config@1 {
			description = "Meraki Sasquatch U-Boot";
			kernel = "kernel-1";

			hash {
				algo = "sha1";
			};
		};

		config@2 {
			description = "Meraki Sasquatch U-Boot";
			kernel = "kernel-1";

			hash {
				algo = "sha1";
			};
		};

		config@3 {
			description = "Meraki Sasquatch U-Boot";
			kernel = "kernel-1";

			hash {
				algo = "sha1";
			};
		};

		config@4 {
			description = "Meraki Sasquatch U-Boot";
			kernel = "kernel-1";

			hash {
				algo = "sha1";
			};
		};
	};
};
```
